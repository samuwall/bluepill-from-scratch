/***********************************************************************************
 ** file           : link.ld 
 ** description    : no libc, no c++, minimal linker script
 **
 **
 **********************************************************************************/

SECTIONS
{
    . = 0x8000000;
    .text :
    {
        *(.vectors)
        *(.text)
    }

}

